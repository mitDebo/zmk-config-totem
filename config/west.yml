## config/west.yml
```yaml
manifest:
  remotes:
    - name: zmkfirmware
      url-base: https://github.com/zmkfirmware
  projects:
    - name: zmk
      remote: zmkfirmware
      revision: main
      import: app/west.yml
    - name: zmk-totem-module
      url: https://github.com/rafiks/zmk-totem-module
      revision: main
      path: modules/zmk-totem-module
  self:
    path: config
```
